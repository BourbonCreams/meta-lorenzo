## meta-lorenzo/conf/layer.conf
```bitbake
# We have a conf and classes directory, add to BBPATH
BBPATH .= ":${LAYERDIR}"

# We have recipes-* directories, add to BBFILES
BBFILES += "${LAYERDIR}/recipes-*/*/*.bb \
            ${LAYERDIR}/recipes-*/*/*.bbappend"

BBFILE_COLLECTIONS += "meta-lorenzo"
BBFILE_PATTERN_meta-lorenzo = "^${LAYERDIR}/"
BBFILE_PRIORITY_meta-lorenzo = "6"

LAYERDEPENDS_meta-lorenzo = "core"
LAYERSERIES_COMPAT_meta-lorenzo = "thud"
```

## meta-lorenzo/conf/machine/raspberrypi3-custom.conf
```bitbake
#@TYPE: RaspberryPi 3 Custom Machine
#@NAME: RaspberryPi 3 Development Board - Custom Machine
#@DESCRIPTION: Machine configuration for the RaspberryPi 3

MACHINEOVERRIDES =. "raspberrypi3:"

DEFAULTTUNE ?= "cortexa7thf-neon-vfpv4"
require conf/machine/include/tune-cortexa7.inc
include conf/machine/include/rpi-base.inc

MACHINE_EXTRA_RRECOMMENDS += "\
    linux-firmware-rpidistro-bcm43430 \
    linux-firmware-rpidistro-bcm43455 \
    bluez-firmware-rpidistro-bcm43430a1-hcd \
    bluez-firmware-rpidistro-bcm4345c0-hcd \
"

SDIMG_KERNELIMAGE ?= "kernel7.img"
UBOOT_MACHINE = "rpi_3_32b_config"
SERIAL_CONSOLES ?= "115200;ttyS0"

ENABLE_UART = "1"
```

## sources/meta-lorenzo/conf/distro/example-distro.conf
```bitbake
MAINTAINER = "lorenzo <lorenzo@test.com>"

require conf/distro/poky.conf

DISTRO = "example-distro"
DISTRO_NAME = "example-distro"
DISTRO_VERSION = "1.0"
DISTRO_CODENAME = "example"
SDK_VENDOR = "-exampledistro"
SD_VERSION = "sdkversion"

# Add hostname
hostname_pn-base-files = "lorenzo"

# Replace sysc with systemd
DISTRO_FEATURES += "systemd "
VIRTUAL-RUNTIME_init_manager = "systemd"
DISTRO_FEATURES_remove += "sysvinit"
VIRTUAL-RUNTIME_initscripts = "systemd-compat-units"
DISTRO_FEATURES_BACKFILL_CONSIDERED += "sysvinit"

# Set time zone
DEFAULT_TIMEZONE =  "Europe/Paris"
```

## sources/meta-lorenzo/conf/layer.conf
```bitbake
# We have a conf and classes directory, add to BBPATH
BBPATH .= ":${LAYERDIR}"

# We have recipes-* directories, add to BBFILES
BBFILES += "${LAYERDIR}/recipes-*/*/*.bb \
            ${LAYERDIR}/recipes-*/*/*.bbappend"

BBFILE_COLLECTIONS += "meta-lorenzo"
BBFILE_PATTERN_meta-lorenzo = "^${LAYERDIR}/"
BBFILE_PRIORITY_meta-lorenzo = "6"

LAYERDEPENDS_meta-lorenzo = "core"
LAYERSERIES_COMPAT_meta-lorenzo = "thud"

# Add OpenCV
IMAGE_INSTALL_append = "opencv "
PREFERRED_VERSION_opencv = "3.4.3+gitAUTOINC+b38c50b3d0_1f6d6f0626_bdb7bb85f3_34e4206aef_fccf7cd6a4"

# Install X11 and xauth
IMAGE_INSTALL_append = "packagegroup-core-x11-base xauth "

# Install htop
IMAGE_INSTALL_append = "htop "
```
